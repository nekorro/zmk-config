## config/west.yml
```yaml
manifest:
  remotes:
    - name: zmkfirmware
      url-base: https://github.com/zmkfirmware
    - name: janpfischer
      url-base: https://github.com/janpfischer
  projects:
    - name: zmk
      remote: zmkfirmware
      revision: v0.3.0
      import: app/west.yml
    - name: zmk-dongle-screen
      remote: janpfischer
      revision: 79d872fa1955ff0159c76ab725e35fd1c01c8ffb
  self:
    path: config
```

## dts/bindings/behaviors/zmk,behavior-layer-alt-tab.yaml
```yaml
description: Hold left Alt after the first Tab until the specified layer is deactivated

compatible: "zmk,behavior-layer-alt-tab"

include: zero_param.yaml

properties:
  release-layer:
    type: int
    required: true
    description: Momentary layer whose deactivation releases this behavior's Alt
```
